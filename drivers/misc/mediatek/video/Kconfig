## drivers/misc/mediatek/video/Kconfig
```kconfig
config MTK_VIDEO
  bool CONFIG_MTK_VIDEO
  default n
  help
    CONFIG_MTK_VIDEO

config KLAPSE_LIVEDISPLAY
  bool CONFIG_KLAPSE_LIVEDISPLAY
  default n
  help
    A simple rgb dynamic lapsing module similar to livedisplay
```
